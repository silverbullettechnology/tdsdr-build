## sbt/user-apps/romfs-hacks/Kconfig
```kconfig
# Configuration options for filesystem tweaks
#
# Copyright 2013,2014 Silver Bullet Technology
#
# Licensed under the Apache License, Version 2.0 (the "License"); you may not use this
# file except in compliance with the License.  You may obtain a copy of the License at:
#   http://www.apache.org/licenses/LICENSE-2.0
#
# Unless required by applicable law or agreed to in writing, software distributed under
# the License is distributed on an "AS IS" BASIS, WITHOUT WARRANTIES OR CONDITIONS OF ANY
# KIND, either express or implied.  See the License for the specific language governing
# permissions and limitations under the License.
#

if USER_APPS_ROMFS_HACKS
 	config USER_APPS_ROMFS_HACKS_FSTAB_MICROSD
	bool "Add /etc/fstab entry for micro-SD card"
	help
	  Select this to add an FSTAB entry to auto-mount the micro-SD card on boot

 	config USER_APPS_ROMFS_HACKS_FSTAB_EMMC
	bool "Add /etc/fstab entry for onboard eMMC"
	help
	  Select this to add an FSTAB entry for the eMMC chip, it is set noauto

endif
```

## sbt/user-apps/sdrdc-stress-test/Kconfig
```kconfig
# Application configuration 
#
# Copyright 2013,2014 Silver Bullet Technology
#
# Licensed under the Apache License, Version 2.0 (the "License"); you may not use this
# file except in compliance with the License.  You may obtain a copy of the License at:
#   http://www.apache.org/licenses/LICENSE-2.0
#
# Unless required by applicable law or agreed to in writing, software distributed under
# the License is distributed on an "AS IS" BASIS, WITHOUT WARRANTIES OR CONDITIONS OF ANY
# KIND, either express or implied.  See the License for the specific language governing
# permissions and limitations under the License.
#
# \copyright Copyright (C) 2013 Silver Bullet Technologies
# vim:ts=4:noexpandtab


if USER_APPS_SDRDC_STRESS_TEST
	comment "No additional options for SDRDC_STRESS_TEST"

 	config USER_APPS_SDRDC_STRESS_TEST_AUTO_RUN
	string "Number of seconds to run for at startup"
	help
	  Set to the number of seconds you want the stress-test to automatically
	  run for at startup, leave blank to startup normally.
endif
```

## sbt/user-apps/vita49-agent/Kconfig
```kconfig
if USER_APPS_VITA49_AGENT
	config USER_APPS_VITA49_AGENT_AUTOLOAD
	bool "Auto start agent at boot"
	help
	  Say Y to autostart the agent at boot.

endif
```

## sbt/user-libs/ad9361/Kconfig.7
```kconfig
# Configuration options for AD9361 userspace driver, library, and tool
#
# Copyright 2013,2014 Silver Bullet Technology
#
# Licensed under the Apache License, Version 2.0 (the "License"); you may not use this
# file except in compliance with the License.  You may obtain a copy of the License at:
#   http://www.apache.org/licenses/LICENSE-2.0
#
# Unless required by applicable law or agreed to in writing, software distributed under
# the License is distributed on an "AS IS" BASIS, WITHOUT WARRANTIES OR CONDITIONS OF ANY
# KIND, either express or implied.  See the License for the specific language governing
# permissions and limitations under the License.
#

if USER_LIBS_AD9361
 	config USER_LIBS_AD9361_READLINE
	bool "Use readline library"
	help
	  Select this to use the GNU readline library for interactive mode; this requires a
	  curses library as well, but provides line editing, tab completion, history, etc.

 	config USER_LIBS_AD9361_STATIC
	bool "Install static library files to target"
	help
	  Select this to copy static library files to the target.  This is only required
	  to compile code on the target itself; if unsure say N.

 	config USER_LIBS_AD9361_INCLUDES
	bool "Install include files to target"
	help
	  Select this to copy include files to the target.  This is only required to
	  compile code on the target itself, and only if using -static; if unsure say N.

	config USER_LIBS_AD9361_INIT_AUTOLOAD
	bool "Auto run init script at boot"
	help
	  Say Y to autorun the init script at boot.

endif
```

## sbt/user-libs/v49_message/Kconfig.7
```kconfig
# Configuration options for VITA49 message library
#
# Copyright 2015 Silver Bullet Technology
#
# Licensed under the Apache License, Version 2.0 (the "License"); you may not use this
# file except in compliance with the License.  You may obtain a copy of the License at:
#   http://www.apache.org/licenses/LICENSE-2.0
#
# Unless required by applicable law or agreed to in writing, software distributed under
# the License is distributed on an "AS IS" BASIS, WITHOUT WARRANTIES OR CONDITIONS OF ANY
# KIND, either express or implied.  See the License for the specific language governing
# permissions and limitations under the License.
#

if USER_LIBS_V49_MESSAGE
 	config USER_LIBS_V49_MESSAGE_STATIC
	bool "Install static library files to target"
	help
	  Select this to copy static library files to the target.  This is only required
	  to compile code on the target itself; if unsure say N.

 	config USER_LIBS_V49_MESSAGE_INCLUDES
	bool "Install include files to target"
	help
	  Select this to copy include files to the target.  This is only required to
	  compile code on the target itself, and only if using -static; if unsure say N.

endif
```

## sbt/user-modules/srio_dev/Kconfig
```kconfig
if USER_MODULES_SRIO_DEV
	config USER_MODULES_SRIO_DEV_AUTOLOAD
	bool "Auto load module at boot"
	help
	  Say Y to autoload the module at boot.

endif
```
